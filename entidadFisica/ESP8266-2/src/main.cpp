#include <PubSubClient_1.h>
#include <ESP8266WiFi.h>

//DEFINES
#define TOPIC_SUBSCRIBE        "yale.uniandes.ml337.key"
#define TOPIC_PUBLISH          "alarms.res1.house1"
#define SIZE_BUFFER_DATA       150

//VARIABLES
String   idDevice = "ISIS2503";
boolean  stringComplete = false;
String   inputString = "";
char     bufferData [SIZE_BUFFER_DATA];

// CLIENTE WIFI & MQTT
WiFiClient       clientWIFI;
PubSubClient     clientMQTT(clientWIFI);

// CONFIG WIFI
const char* ssid = "isis2503";
const char* password = "Yale2018.";

// CONFIG MQTT
// CONFIG MQTT
unsigned char m2mqtt_ca_bin_crt[] = {
  0x30, 0x82, 0x03, 0xfb, 0x30, 0x82, 0x02, 0xe3, 0xa0, 0x03, 0x02, 0x01,
  0x02, 0x02, 0x09, 0x00, 0xc4, 0x6c, 0x11, 0xc4, 0x9d, 0x18, 0x2c, 0xcb,
  0x30, 0x0d, 0x06, 0x09, 0x2a, 0x86, 0x48, 0x86, 0xf7, 0x0d, 0x01, 0x01,
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  0x7e, 0xfd, 0xc6
};

unsigned int m2mqtt_ca_bin_crt_len = 1023;

IPAddress serverMQTT (172,24,41,153);
const uint16_t portMQTT = 8083;
const char* usernameMQTT = "microcontrolador";
const char* passwordMQTT = "Isis2503";

// FUNCTIONS
String macToStr(const uint8_t* mac) {
  String result;
  for (int i = 0; i < 6; ++i) {
    result += String(mac[i], 16);
    if (i < 5)
      result += ':';
  }
  return result;
}

void connectWIFI() {
  // Conectar a la red WiFi
  Serial.println();
  Serial.print("Connecting to ");
  Serial.println(ssid);

  WiFi.mode(WIFI_STA);
  if(WiFi.status() != WL_CONNECTED) {
    WiFi.begin(ssid, password);
  }

  while (WiFi.status() != WL_CONNECTED) {
    delay(500);
    Serial.print(".");
  }
  Serial.println("WiFi connected");

  // Obtain MAC Address
  uint8_t mac[6];
  WiFi.macAddress(mac);
  idDevice = macToStr(mac);
  Serial.print("MAC Address: ");
  Serial.println(idDevice);

  // Obtain IP Address
  Serial.print("IP Address: ");
  Serial.println(WiFi.localIP());
}

void reconnectWIFI() {
  // Conectar a la red WiFi
  if(WiFi.status() != WL_CONNECTED) {
    WiFi.begin(ssid, password);
  }

  while (WiFi.status() != WL_CONNECTED) {
    delay(500);
  }
}

boolean connectMQTT() {
  boolean connectMQTT = false;
  if (!clientMQTT.connected()) {
    if (clientMQTT.connect(idDevice.c_str(), usernameMQTT, passwordMQTT)) {
      connectMQTT = true;
    }
  }
  else {
    connectMQTT = true;
  }

  if(connectMQTT) {
    if(clientMQTT.subscribe(TOPIC_SUBSCRIBE)) {
      // Serial.println("Subscribe OK");
    }
  }
  return connectMQTT;
}

void callback(char* topic, byte* payload, unsigned int length) {
  Serial.write(payload, length);
  Serial.println();
}

void setup() {
  Serial.begin(9600);
  inputString.reserve(150);
  // clientWIFI.setCACert(m2mqtt_ca_bin_crt, m2mqtt_ca_bin_crt_len);

  clientMQTT.setServer(serverMQTT, portMQTT);
  clientMQTT.setCallback(callback);
  connectWIFI();
  delay(1000);
  if (connectMQTT()) {
    Serial.println("MQTT connected!!!");
  }
  delay(1000);
}

void processData() {
  if (stringComplete) {
    if (WiFi.status() != WL_CONNECTED) {
      reconnectWIFI();
    }

    if (WiFi.status() == WL_CONNECTED) {
      if (!clientMQTT.connected()) {
        connectMQTT();
      }

      if (clientMQTT.connected()) {
        if(clientMQTT.publish(TOPIC_PUBLISH, bufferData)) {
          inputString = "";
          stringComplete = false;
        }
      }
    }
  }
  clientMQTT.loop();
}

void receiveData() {
  while (Serial.available()) {
    char inChar = (char)Serial.read();
    inputString += inChar;

    if (inChar == '\n') {
      inputString.toCharArray(bufferData, SIZE_BUFFER_DATA);
      stringComplete = true;
    }
  }
}

void loop() {
  receiveData();
  processData();
}
